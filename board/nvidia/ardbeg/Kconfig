## board/nvidia/ardbeg/Kconfig
```kconfig
if TARGET_ARDBEG

config SYS_BOARD
	default "ardbeg"

config SYS_VENDOR
	default "nvidia"

config SYS_CONFIG_NAME
	default "ardbeg"

endif
```

## board/nvidia/shieldtablet/Kconfig
```kconfig
if TARGET_SHIELDTABLET

config SYS_BOARD
	default "shieldtablet"

config SYS_VENDOR
	default "nvidia"

config SYS_CONFIG_NAME
	default "shieldtablet"

endif
```
